## main/Kconfig.projbuild
```kconfig
menu "Gemstone Cam"

    config GEMCAM_WIFI_SSID
        string "WiFi network to join"
        default ""
        help
            Leave empty to have the board create its own hotspot instead.
            If the network can't be joined, the board falls back to the hotspot.

    config GEMCAM_WIFI_PASSWORD
        string "WiFi password"
        default ""

    config GEMCAM_AP_SSID
        string "Hotspot name"
        default "GemCam"

    config GEMCAM_AP_PASSWORD
        string "Hotspot password (8+ characters)"
        default "gemstone1"

    config GEMCAM_MODEL_NAME
        string "Name shown for the trained AI model"
        default "Gr3nSky Gemstone Cam"
        help
            Shown on the web page and in the start-up log. Leave empty to use the
            Edge Impulse project name from the exported model.

    config GEMCAM_XCLK_GPIO
        int "Camera XCLK pin (-1 = module has its own oscillator)"
        range -1 48
        default -1
        help
            ALIENTEK-style modules (no XCLK pin on the header) clock themselves.
            For modules that do have an XCLK pin, wire it to GPIO 15 and set 15.

    config GEMCAM_PWDN_GPIO
        int "Camera PWDN pin (-1 = tied to GND)"
        range -1 48
        default 14
        help
            Lets the ESP32 power-cycle the camera when it starts up in a bad state.

    config GEMCAM_RESET_GPIO
        int "Camera RST pin (-1 = tied to 3.3V)"
        range -1 48
        default 21
        help
            Lets the ESP32 hard-reset the camera when it starts up in a bad state.

    config GEMCAM_XCLK_MHZ
        int "Camera XCLK (MHz)"
        range 5 20
        default 10
        help
            Only matters when an XCLK pin is set. 10 MHz is reliable over jumpers.

    config GEMCAM_SENSOR_CLK_DIV
        int "Sensor clock divider (0 = full speed)"
        range 0 7
        default 0
        help
            The sensor runs at its clock / (n + 1). Raise to 1 or 2 if the
            picture is striped or corrupted over jumper wires; the frame rate
            drops by the same factor.

endmenu
```
